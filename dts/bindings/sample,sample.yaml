## dts/bindings/sample,sample.yaml
```yaml
description: sample driver for reference

compatible: "sample,sample"

include: [sensor-device.yaml, i2c-device.yaml]
```

## dts/bindings/sensor/mysample,sample.yaml
```yaml
description: sample driver for reference

compatible: "mysample,sample"

include: [sensor-device.yaml, i2c-device.yaml]
```

## sensor/sample/Kconfig
```kconfig
config SAMPLE
    bool "Sample sensor"
    default y
    depends on DT_HAS_ZEPHYR_SAMPLE_ENABLED
    select I2C
    help
        Enable sample sensor driver
```
